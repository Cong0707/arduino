//
// Created by Fir on 2024/3/7 007.
//

#include <vector>
#include "astra_rocket.h"

#include <iomanip>
#include <astra/ui/item/page/page.h>
#include <astra/ui/item/widget/widget.h>

#include "astra/astra_logo.h"
#include "hal/cong/TFTHAL.h"

std::vector<uint8_t> moon = {
    0xFF, 0xFF, 0xFF, 0x3F, 0xFF, 0xFF, 0xFF, 0x3F, 0xFF, 0xFF, 0xFF, 0x3F, 0xFF, 0xFF, 0xF1, 0x3F,
    0xFF, 0xFF, 0xC3, 0x3F, 0xFF, 0xFF, 0x87, 0x3F, 0xFF, 0xFF, 0x07, 0x3F, 0xFF, 0xFF, 0x0F, 0x3E,
    0xFF, 0xFF, 0x0F, 0x3E, 0xFF, 0xFF, 0x0F, 0x3C, 0xFF, 0xFF, 0x0F, 0x3C, 0xFF, 0xFF, 0x0F, 0x38,
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    0xFF, 0xFF, 0xFF, 0x3F, 0xFF, 0xFF, 0xFF, 0x3F
};

std::vector<uint8_t> tuning = {
    0xFF, 0xFF, 0xFF, 0x3F, 0xFF, 0xFF, 0xFF, 0x3F, 0xFF, 0xFF, 0xFF, 0x3F, 0xFF, 0xF9, 0xE7, 0x3F,
    0xFF, 0xF9, 0xE7, 0x3F, 0xFF, 0xF9, 0xE7, 0x3F, 0xFF, 0xF0, 0xE7, 0x3F, 0x7F, 0xE0, 0xE7, 0x3F,
    0x7F, 0xE0, 0xC3, 0x3F, 0x7F, 0xE0, 0xC3, 0x3F, 0x7F, 0xE0, 0xC3, 0x3F, 0x7F, 0xE0, 0xE7, 0x3F,
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    0xFF, 0xFF, 0xFF, 0x3F, 0xFF, 0xFF, 0xFF, 0x3F
};

std::vector<uint8_t> sci = {
    0xFF, 0xFF, 0xFF, 0x3F, 0xFF, 0xFF, 0xFF, 0x3F, 0xEF, 0xFF, 0xFF, 0x3F, 0xC7, 0xFF, 0xFF, 0x3F,
    0xC7, 0xF3, 0xFF, 0x3F, 0x83, 0xC0, 0xFF, 0x3F, 0xEF, 0xCC, 0xFF, 0x3F, 0x6F, 0x9E, 0xFF, 0x3F,
    0x6F, 0x9E, 0xFF, 0x3F, 0x2F, 0x3F, 0xFF, 0x3F, 0x2F, 0x3F, 0xFF, 0x3F, 0x8F, 0x7F, 0xFE, 0x3F,
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    0xFF, 0xFF, 0xFF, 0x3F, 0xFF, 0xFF, 0xFF, 0x3F
};

std::vector<uint8_t> settings = {
    0xFF, 0xFF, 0xFF, 0x3F, 0xFF, 0xFF, 0xFF, 0x3F, 0xFF, 0xFF, 0xFF, 0x3F, 0xFF, 0xFF, 0xFF, 0x3F,
    0xFF, 0x1F, 0xFE, 0x3F, 0xFF, 0x1F, 0xFE, 0x3F, 0xFF, 0x0C, 0xCC, 0x3F, 0x7F, 0x00, 0x80, 0x3F,
    0x3F, 0x00, 0x00, 0x3F, 0x3F, 0xE0, 0x01, 0x3F, 0x7F, 0xF8, 0x87, 0x3F, 0x7F, 0xFC, 0x8F, 0x3F,
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    0xFF, 0xFF, 0xFF, 0x3F, 0xFF, 0xFF, 0xFF, 0x3F
};

astra::Launcher* astraLauncher = new astra::Launcher();

void astraCoreInit()
{
    HAL::inject(new TFTHAL);

    HAL::screenOn();
    HAL::setSelectFont(1);

    HAL::printInfo("tft_espi_init()");
    HAL::delay(100);
    HAL::printInfo("loading...");
    HAL::delay(50);

    astra::drawLogo(200);

    astra::Menu* rootPage = new astra::Tile("主菜单");

    rootPage->addItem(new astra::List("test1", moon));
    rootPage->addItem(new astra::List("测试2", tuning));
    rootPage->addItem(new astra::List("测试测试3", sci));

    astra::Menu* secondPage = new astra::List("设置", settings);
    rootPage->addItem(secondPage);
    secondPage->addItem(new astra::Divider("网络设置"));
    secondPage->addItem(new cong::Wifi("Wifi", tuning));
    secondPage->addItem(new cong::AP("个人热点", tuning));

    astraLauncher->init(rootPage);
}

void astraCoreUpdate()
{
    astraLauncher->update();
}

void astraCoreTest()
{
    for (;;)
    {
        HAL::startKeyScan();
        if (HAL::isLeft()) HAL::printInfo("left");
        else if (HAL::isRight()) HAL::printInfo("right");
        else if (HAL::isConfirm()) HAL::printInfo("confirm");
        else if (HAL::isCancel()) HAL::printInfo("cancel");
    }
}

void astraCoreDestroy()
{
    HAL::destroy();
    delete astraLauncher;
}
